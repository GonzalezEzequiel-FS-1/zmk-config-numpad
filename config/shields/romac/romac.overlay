/ {
    chosen {
        zmk,kscan = &direct_keys;
    };

    direct_keys: kscan {
        compatible = "zmk,kscan-directgpio";
        label = "Direct GPIO Keys";

        input-gpios = <&gpio0 10 (GPIO_ACTIVE_HIGH | GPIO_PULL_DOWN)>;

        keymap = <0>;
    };
};
