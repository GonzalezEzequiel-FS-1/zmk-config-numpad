/ {
    chosen {
        zmk,kscan = &default_kscan;
        zmk,matrix-transform = &default_transform;
    };

    default_kscan: kscan {
        compatible = "zmk,kscan-gpio-matrix";
        label = "default_kscan";
        diode-direction = "col2row"; // Verify: anode to column, cathode to row

        col-gpios = <&pro_micro 18 GPIO_ACTIVE_HIGH>,  // C3, P1.15 (D18, printed 115)
                    <&pro_micro 21 GPIO_ACTIVE_HIGH>,  // C2, P0.31 (D21, printed 031)
                    <&pro_micro 20 GPIO_ACTIVE_HIGH>,  // C1, P0.29 (D20, printed 029)
                    <&pro_micro 19 GPIO_ACTIVE_HIGH>;  // C0, P0.02 (D19, printed 002)

        row-gpios = <&pro_micro 3 (GPIO_ACTIVE_HIGH | GPIO_PULL_DOWN)>,   // R0, P0.06 (D1, printed 006)
                    <&pro_micro 2 (GPIO_ACTIVE_HIGH | GPIO_PULL_DOWN)>,   // R1, P0.08 (D0, printed 008)
                    <&pro_micro 5 (GPIO_ACTIVE_HIGH | GPIO_PULL_DOWN)>,   // R2, P0.17 (D2, printed 017)
                    <&pro_micro 6 (GPIO_ACTIVE_HIGH | GPIO_PULL_DOWN)>,   // R3, P0.22 (D4, printed 022)
                    <&pro_micro 4 (GPIO_ACTIVE_HIGH | GPIO_PULL_DOWN)>;   // R4, P0.20 (D3, printed 020)
    };

    default_transform: matrix_transform {
        compatible = "zmk,matrix-transform";
        rows = <5>;
        columns = <4>;
        map = <3 2 1 0 7 6 5 11 10 9 8 15 14 13 19 17 16>;
    };
};